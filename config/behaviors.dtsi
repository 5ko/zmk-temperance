/*
 * Copyright (c) 2024 Petko Yotov pmwiki.org/petko
 *
 * SPDX-License-Identifier: MIT
 */


// Simple macros
ZMK_MACRO(nxkbly,  bindings = <&kp GLOBE &kp LA(LSHFT)> ;)
ZMK_MACRO(https,   bindings = <&kp H &kp T &kp T &kp P &kp S 
                      &kp COLON &kp SLASH &kp SLASH 
                      &kp W &kp W &kp W &kp DOT > ;)

ZMK_MACRO(a_grave, bindings = <&kp D_GRV &kp A> ;)
ZMK_MACRO(a_circ,  bindings = <&kp D_CRC &kp A> ;)
ZMK_MACRO(e_acute, bindings = <&kp D_ACU &kp E> ;)
ZMK_MACRO(e_circ,  bindings = <&kp D_CRC &kp E> ;)
ZMK_MACRO(e_grave, bindings = <&kp D_GRV &kp E> ;)
ZMK_MACRO(e_dier,  bindings = <&kp D_DRS &kp E> ;)
ZMK_MACRO(u_grave, bindings = <&kp D_GRV &kp U> ;)
ZMK_MACRO(u_circ,  bindings = <&kp D_CRC &kp U> ;)
ZMK_MACRO(i_circ,  bindings = <&kp D_CRC &kp I >;)
ZMK_MACRO(i_dier,  bindings = <&kp D_DRS &kp I> ;)
ZMK_MACRO(o_circ,  bindings = <&kp D_CRC &kp O> ;)
ZMK_MACRO(u_dier,  bindings = <&kp D_DRS &kp U> ;)

// unused at the moment
// ZMK_MACRO(th,      bindings = <&kp T &kp H> ;)
// ZMK_MACRO(the,     bindings = <&kp T &kp H &kp E> ;)
// ZMK_MACRO(ing,     bindings = <&kp I &kp N &kp G> ;)
// ZMK_MACRO(ion,     bindings = <&kp I &kp O &kp N> ;)
// ZMK_MACRO(tion,    bindings = <&kp T &kp I &kp O &kp N> ;)

// Simple hold-tabs, hold-preferred
#define HTHP(name, ...)  \
  / { \
    behaviors { \
      name: name { \
        compatible = "zmk,behavior-hold-tap"; \
        flavor = "hold-preferred"; \
        tapping-term-ms = <HOLDTAP_TERM>; \
        #binding-cells = <2>;\
        __VA_ARGS__ \
      }; \
    }; \
  };


HTHP(hold_esc,      bindings = <&unmod>, <&kp>;)
HTHP(nx_kp,         bindings = <&nxkbly>, <&kp>;) // nxkbly, kp CAPS
HTHP(a_grave_circ,  bindings = <&a_circ>, <&a_grave>;)
HTHP(e_acute_circ,  bindings = <&e_circ>, <&e_acute>;)
HTHP(e_grave_dier,  bindings = <&e_dier>, <&e_grave>;)
HTHP(u_grave_circ,  bindings = <&u_circ>, <&u_grave>;)
HTHP(i_circ_dier,   bindings = <&i_dier>, <&i_circ>;)
HTHP(o_circ_u_dier, bindings = <&u_dier>, <&o_circ>;)


HTHP(sk_tk, bindings = <&sk>, <&kt>;) // sk LGUI kt LCTRL; sk RALT kt LALT
HTHP(lk, bindings = <&lay_on>, <&kp>;)

// unused at the moment
// HTHP(the_th, bindings = <&tap_the>, <&tap_th>;)
// HTHP(ion_ing, bindings = <&ion>, <&ing>;)
// HTHP(kp_kt, bindings = <&kp>, <&kt>;)// kp_kt CAPS LSHFT
// HTHP(nx_sk, bindings = <&nxkbly>, <&sk>;)// nxkbly, sk LSHFT


// Hold-Tap NoShift NoShift
#define HTNSNS(name, keycode1, keycode2)  \
  / { \
    behaviors { \
      ns1_##name: behavior_unshift1_##name { \
        compatible = "zmk,behavior-mod-morph"; \
        #binding-cells = <0>;\
        bindings = <&kp keycode1>, <&kp keycode1>;\
        mods = <(MOD_LSFT|MOD_RSFT)>;\
        keep-mods = <(MOD_RALT)>; \
      }; \
      ns2_##name: behavior_unshift2_##name { \
        compatible = "zmk,behavior-mod-morph"; \
        #binding-cells = <0>;\
        bindings = <&kp keycode2>, <&kp keycode2>;\
        mods = <(MOD_LSFT|MOD_RSFT)>;\
        keep-mods = <(MOD_RALT)>; \
      }; \
      mt_##name: behavior_mt_##name {\
        compatible = "zmk,behavior-hold-tap"; \
        flavor = "hold-preferred"; \
        tapping-term-ms = <HOLDTAP_TERM>; \
        #binding-cells = <2>;\
        bindings = <&ns1_##name>, <&ns2_##name>;\
      }; \
    }; \
  };
  

  
// Hold-Tap NoShift KeyPress
#define HTNSKP(name, keycode)  \
  / { \
    behaviors { \
      ns_##name: behavior_unshift_##name { \
        compatible = "zmk,behavior-mod-morph"; \
        #binding-cells = <0>;\
        bindings = <&kp keycode>, <&kp keycode>;\
        mods = <(MOD_LSFT|MOD_RSFT)>;\
        keep-mods = <(MOD_RALT)>; \
      }; \
      mt_##name: behavior_mt_##name {\
        compatible = "zmk,behavior-hold-tap"; \
        flavor = "hold-preferred"; \
        tapping-term-ms = <HOLDTAP_TERM>; \
        #binding-cells = <2>;\
        bindings = <&ns_##name>, <&kp>;\
      }; \
    }; \
  };
  
// Hold-Tap KeyPress NoShift
#define HTKPNS(name, keycode)  \
  / { \
    behaviors { \
      ns_##name: behavior_unshift_##name { \
        compatible = "zmk,behavior-mod-morph"; \
        #binding-cells = <0>;\
        bindings = <&kp keycode>, <&kp keycode>;\
        mods = <(MOD_LSFT|MOD_RSFT)>;\
        keep-mods = <(MOD_RALT)>; \
      }; \
      mt_##name: behavior_mt_##name {\
        compatible = "zmk,behavior-hold-tap"; \
        flavor = "hold-preferred"; \
        tapping-term-ms = <HOLDTAP_TERM>; \
        #binding-cells = <2>;\
        bindings = <&kp>, <&ns_##name>;\
      }; \
    }; \
  };
  
HTNSNS( dot_comma, DOT, COMMA)
#define dot_comma &mt_dot_comma 0 0

HTNSNS( dgrave_bslh, D_GRV, BSLH)
#define dgrave_bslh &mt_dgrave_bslh 0 0

HTNSNS( dacute_fslh, D_ACU, FSLH)
#define dacute_fslh &mt_dacute_fslh 0 0




HTKPNS( colon_semi, SEMI)
#define colon_semi &mt_colon_semi COLON 0

HTKPNS( dqt_sqt, SQT)
#define dqt_sqt &mt_dqt_sqt DQT 0



// creates &mt_dgrave_kp 0 KEYCODE and &mt_kp_dgrave KEYCODE 0
// Unshift(dgrave, D_GRV) 
// NS(noshift_acute, D_ACU)
// NS(noshift_circ, D_CRC)

// HTHP(gr_bs,      bindings = <&noshift_grave>, <&kp>;)


/ { behaviors {
  mtz: behavior_mod_tap_zero {
    // 
    compatible = "zmk,behavior-hold-tap";
    #binding-cells = <2>;
    flavor = "hold-preferred";
    tapping-term-ms = <10>;
//     quick-tap-ms = <200>;
//     require-prior-idle-ms = <125>;
    bindings = <&kp>, <&kp>;
  };
  
  
  tap2: macro_tap_2 {
    compatible = "zmk,behavior-macro-two-param";
    wait-ms = <40>;
    tap-ms = <40>;
    #binding-cells = <2>;
    bindings
      = <&macro_param_1to1>
      , <&macro_tap &kp MACRO_PLACEHOLDER>
      , <&macro_param_2to1>
      , <&macro_tap &kp MACRO_PLACEHOLDER>
      ;
  };
  
  kd: behavior_keydown {
    compatible = "zmk,behavior-key-toggle";
    #binding-cells = <1>;
    display-name = "Key Toggle On";
    toggle-mode = "on";
  };

  ku: behavior_keyup {
    compatible = "zmk,behavior-key-toggle";
    #binding-cells = <1>;
    display-name = "Key Toggle Off";
    toggle-mode = "off";
  };
  
  lay_off: behavior_layer_off {
    compatible = "zmk,behavior-toggle-layer";
    #binding-cells = <1>;
    display-name = "Toggle Layer Off";
    toggle-mode = "off";

  };
  lay_on: behavior_layer_om {
    compatible = "zmk,behavior-toggle-layer";
    #binding-cells = <1>;
    display-name = "Toggle Layer On";
    toggle-mode = "on";
  };
    
  unmod: macro_release_mods {
    compatible = "zmk,behavior-macro";
    #binding-cells = <0>;
    bindings
      = <&lay_off L_MSE &lay_off L_BLE &lay_off L_NUM
         &lay_off L_ACC &lay_off L_EDT &lay_off L_FUN>
      , <&ku LSHFT &ku LCTRL &ku LALT &ku RALT &ku LGUI>
      ;
  };
  

  


}; };


// Macro to apply momentary-layer-on-hold/toggle-layer-on-tap to a specific layer
#define SK_TK(key) &sk_tk key key

// Accented letters on L_ACC
// #define A_IC_ID &i_circ_dier   0 0  
// #define A_UG_UC &u_grave_circ  0 0 
// #define A_AG_AC &a_grave_circ  0 0 
// #define A_OC_UD &o_circ_u_dier 0 0
// #define A_EG_ED &e_grave_dier  0 0 
// #define A_EA_EC &e_acute_circ  0 0 


